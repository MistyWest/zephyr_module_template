## dts/bindings/misty,template-group.yaml
```yaml
compatible: "misty,template-group"

description: Template demo for passing multiple values to the template.

properties:
  mw_templates:
    type: phandle-array
    required: true
    description: Array of phandles to template-instance nodes.
```

## dts/bindings/misty,template-instance.yaml
```yaml
compatible: "misty,template-instance"

description: Individual template instance configuration.

properties:
  value:
    type: int
    required: true
    description: Template Value.

  label:
    type: string
    required: true
    description: Human-readable name for this template value.
```

## test/testcase.yaml
```yaml
tests:
  module.tester:
    sysbuild: true
    platform_allow:
      - native_sim
    integration_platforms:
      - native_sim
    tags:
      - template_test
      - zbus
      - sysbuild
```
